## drivers/gpu/drm/pvdrm/Kconfig
```kconfig
config DRM_PVDRM
	tristate "PV DRM driver"
	depends on DRM && PCI
        select FW_LOADER
	select DRM_KMS_HELPER
	select DRM_TTM
	select FB_CFB_FILLRECT
	select FB_CFB_COPYAREA
	select FB_CFB_IMAGEBLIT
	select FB
	select FRAMEBUFFER_CONSOLE if !EXPERT
	select ACPI_VIDEO if ACPI && X86 && BACKLIGHT_CLASS_DEVICE && VIDEO_OUTPUT_CONTROL && INPUT
	select ACPI_WMI if ACPI
	select MXM_WMI if ACPI
	select POWER_SUPPLY
	help
	  Choose this option for open-source Para-Virtualized DRM driver support.
```
